## drivers/nubia/Kconfig
```kconfig
#
# Nubia drivers configuration
#

menu "nubia drivers"

config NUBIA_DRIVERS
	bool "NUBIA DRIVERS"
	default n
	help
	  Say Y here if you want to enable NUBIA DRIVERS
	  If unsure, say N.

comment "Nubia Device Drivers"

if NUBIA_DRIVERS

config NUBIA_TOUCH
        bool "NUBIA_TOUCH"
        default n
        help
         Say Y here if you have enable NUBIA_TOUCH
         IF  unsure ,say N

endif

if NUBIA_TOUCH
source "drivers/nubia/touch/Kconfig"
endif

endmenu
```
